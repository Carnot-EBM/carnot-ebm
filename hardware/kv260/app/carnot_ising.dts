/*
 * Device-tree overlay for the Carnot Ising sampler on KV260.
 *
 * RETRO-074 ROOT CAUSE (after hangs #1-#12):
 *   The prior version of this overlay targeted the root path `/` and
 *   declared a `clocking0` + firmware-name, but targeted NOTHING at
 *   fpga_full.  Worse, it declared no `resets` property at all.  The
 *   Linux fpga-manager flow on Kria performs bitstream load AND
 *   releases the PL-side AXI-isolation reset signals (zynqmp_reset
 *   ids 0x74-0x77) ONLY when the overlay targets the `fpga_full`
 *   fpga-region and lists those resets.  Without that targeting, the
 *   bitstream loaded (PL fabric reported "operating") but the PS-PL
 *   AXI isolation stayed asserted — every AXI transaction from the PS
 *   master wedged silently because the PS-PL boundary was literally
 *   cut off, not just the slave held in reset.  The behaviour matched
 *   the symptom: loadapp succeeds, /dev/uio4 appears, passive idle is
 *   fine, but the first AXI access from user-space hangs CPU3 on the
 *   ARM load instruction and cascades into RCU stall + mmc1 timeouts.
 *
 *   This overlay now follows the k26-starter-kits structure:
 *     Fragment@0 → targets fpga_full, declares firmware-name +
 *                  resets = <zynqmp_reset 0x74..0x77>, which is what
 *                  actually triggers PL fabric reset-release.
 *     Fragment@1 → targets &amba, declares our UIO slave at 0xA0000000.
 *
 *   The clocking0 fragment is removed — prior experiments showed Kria's
 *   fclk framework ignores overlay assigned-clock-rates anyway (pl_clk0
 *   stays at whatever boot set it to, typically DIVISOR0=25 → 60 MHz).
 */
/dts-v1/;
/plugin/;

/ {
	compatible = "xlnx,zynqmp";

	/*
	 * Fragment 0: tell fpga-manager to load the PL image AND release the
	 * PL-side AXI isolation resets.  This is the magic that the old
	 * overlay was missing.  The reset indices 0x74..0x77 are lifted
	 * verbatim from /lib/firmware/xilinx/k26-starter-kits/k26_starter_kits.dtbo
	 * (the Xilinx-provided reference app that works).  They correspond to
	 * PL AXI master / AXI isolation resets in the ZynqMP CRL_APB +
	 * zynqmp_reset driver.
	 */
	fragment@0 {
		target = <&fpga_full>;
		__overlay__ {
			#address-cells = <2>;
			#size-cells = <2>;
			firmware-name = "carnot_ising_v2_n64.bit.bin";
			resets = <&zynqmp_reset 0x74>,
			         <&zynqmp_reset 0x75>,
			         <&zynqmp_reset 0x76>,
			         <&zynqmp_reset 0x77>;
		};
	};

	/*
	 * Fragment 1: AXI-Lite slave as a UIO device.  User-space opens
	 * /dev/uio<N> and mmaps the register window — kernel FPGA-manager/UIO
	 * core handles the AXI timing properly.
	 */
	fragment@1 {
		target = <&amba>;
		__overlay__ {
			#address-cells = <2>;
			#size-cells = <2>;

			ising_sampler@a0000000 {
				compatible = "generic-uio";
				reg = <0x0 0xa0000000 0x0 0x20000>;
				status = "okay";
			};
		};
	};
};
